/**
 * MeshCue Node — Firmware
 * Dedicated hardware node for the MeshCue decentralized mesh network. Runs 24/7, relays signals, participates in consensus, and displays live mesh status. Designed to be 3D printed and assembled at home.
 * Generated by MeshCue Forge v0.1.0
 */

#include <Arduino.h>
#include <Wire.h>
#include <Adafruit_GFX.h>
#include <Adafruit_SSD1306.h>

// ─── Pin Definitions ───────────────────────────
#define PIN_MCU_LED_GREEN_ANODE 1
#define PIN_MCU_LED_YELLOW_ANODE 2
#define PIN_MCU_LED_RED_ANODE 3
#define PIN_MCU_OLED_SDA 8
#define PIN_MCU_OLED_SCL 9
#define PIN_MCU_BTN_PAIR_SIG 4
#define PIN_MCU_BTN_RESET_SIG 5
#define PIN_MCU_BUZZER_SIG 6
#define PIN_LED_GREEN_ANODE 1
#define PIN_LED_YELLOW_ANODE 2
#define PIN_LED_RED_ANODE 3
#define PIN_OLED_SDA 8
#define PIN_OLED_SCL 9
#define PIN_BTN_PAIR_SIG 4
#define PIN_BTN_RESET_SIG 5
#define PIN_BUZZER_SIG 6

// ─── Globals ──────────────────────────────────
unsigned long lastUpdate = 0;
const unsigned long UPDATE_INTERVAL = 1000;
#define SCREEN_WIDTH 128
#define SCREEN_HEIGHT 64
Adafruit_SSD1306 display(SCREEN_WIDTH, SCREEN_HEIGHT, &Wire, -1);
bool btn_pair_pressed = false;
bool btn_pair_last = false;
unsigned long btn_pair_debounce = 0;
bool btn_reset_pressed = false;
bool btn_reset_last = false;
unsigned long btn_reset_debounce = 0;

void setup() {
  Serial.begin(115200);
  Serial.println(F("MeshCue Node starting..."));

  pinMode(PIN_LED_GREEN_ANODE, OUTPUT); // led_green (green LED)

  pinMode(PIN_LED_YELLOW_ANODE, OUTPUT); // led_yellow (yellow LED)

  pinMode(PIN_LED_RED_ANODE, OUTPUT); // led_red (red LED)

  Wire.begin(8, 9);
  if (!display.begin(SSD1306_SWITCHCAPVCC, 0x3C)) {
    Serial.println(F("SSD1306 allocation failed"));
    for (;;);
  }
  display.clearDisplay();
  display.setTextSize(1);
  display.setTextColor(SSD1306_WHITE);
  display.setCursor(0, 0);
  display.println(F("MeshCue v1.0"));
  display.display();

  pinMode(PIN_BTN_PAIR_SIG, INPUT_PULLUP); // btn_pair

  pinMode(PIN_BTN_RESET_SIG, INPUT_PULLUP); // btn_reset

  pinMode(PIN_BUZZER_SIG, OUTPUT); // buzzer (buzzer)

  Serial.println(F("Ready."));
}

void loop() {
  // btn_pair debounce
  bool btn_pair_read = !digitalRead(PIN_BTN_PAIR_SIG);
  if (btn_pair_read != btn_pair_last) btn_pair_debounce = millis();
  if (millis() - btn_pair_debounce > 50) btn_pair_pressed = btn_pair_read;
  btn_pair_last = btn_pair_read;
  // btn_reset debounce
  bool btn_reset_read = !digitalRead(PIN_BTN_RESET_SIG);
  if (btn_reset_read != btn_reset_last) btn_reset_debounce = millis();
  if (millis() - btn_reset_debounce > 50) btn_reset_pressed = btn_reset_read;
  btn_reset_last = btn_reset_read;

  // Periodic update
  if (millis() - lastUpdate >= UPDATE_INTERVAL) {
    lastUpdate = millis();
    // TODO: Add your periodic logic here
  }

  delay(10);
}

// ─── Functions ────────────────────────────────
void set_led_green(bool on) {
  digitalWrite(PIN_LED_GREEN_ANODE, on ? HIGH : LOW);
}

void set_led_yellow(bool on) {
  digitalWrite(PIN_LED_YELLOW_ANODE, on ? HIGH : LOW);
}

void set_led_red(bool on) {
  digitalWrite(PIN_LED_RED_ANODE, on ? HIGH : LOW);
}

void display_text(const char* line1, const char* line2) {
  display.clearDisplay();
  display.setCursor(0, 0);
  display.setTextSize(1);
  display.println(line1);
  display.setCursor(0, 16);
  display.println(line2);
  display.display();
}

void beep(unsigned int frequency, unsigned long duration) {
  tone(PIN_BUZZER_SIG, frequency, duration);
}

void beep_success() { beep(1000, 100); delay(50); beep(1500, 100); }
void beep_error() { beep(400, 300); }
void beep_alert() { beep(2000, 50); delay(50); beep(2000, 50); delay(50); beep(2000, 50); }
